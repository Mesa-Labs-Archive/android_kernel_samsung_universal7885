/*
 * SAMSUNG UNIVERSAL7885 board device tree source
 *
 * Copyright (c) 2013 Samsung Electronics Co., Ltd.
 *		http://www.samsung.com
 *
 * This program is free software; you can redistribute it and/or modify
 * it under the terms of the GNU General Public License version 2 as
 * published by the Free Software Foundation.
*/

/dts-v1/;
#include "exynos7884-j7topelte_common.dtsi"
#include "exynos7884-j7topelte_usa_gpio_01.dtsi"
//#include "exynos7884-j7topelte_svcled.dtsi"

/ {
	model = "Samsung J7TOPELTE VZW rev01 board based on EXYNOS7884";
	model_info-chip = <7885>;
	model_info-platform = "android";
	model_info-subtype = "samsung";
	model_info-hw_rev = <1>;
	model_info-hw_rev_end = <255>;
	compatible = "samsung, J7TOPELTE VZW rev01", "samsung,Universal7884";
};

