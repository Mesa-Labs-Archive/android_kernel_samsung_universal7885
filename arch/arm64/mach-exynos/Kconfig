## arch/arm64/mach-exynos/Kconfig
```kconfig
# arch/arm64/mach-exynos/Kconfig
#
# Copyright (c) 2016 Samsung Electronics Co., Ltd.
#		http://www.samsung.com/
#
# Licensed under GPLv2

# Configuration options for the EXYNOS7

if ARCH_EXYNOS

menu "SAMSUNG EXYNOS SoCs Support"

choice
	prompt "Exynos device target"
	default MACH_EXYNOS7885_JACKPOTLTE_EUR_OPEN

config MACH_EXYNOS7884_A6ELTE_USA
	bool "Galaxy A6 (SM-A600P)"
	select SOC_EXYNOS7884

config MACH_EXYNOS7885_A7Y18LTE_EUR_OPEN
	bool "Galaxy A7 2018 (SM-A750FN)"
	select SOC_EXYNOS7885

config MACH_EXYNOS7885_JACKPOT2LTE_EUR_OPEN
	bool "Galaxy A8+ (SM-A730F)"
	select SOC_EXYNOS7885

config MACH_EXYNOS7885_JACKPOTLTE_CAN_OPEN
	bool "Galaxy A8 (SM-A530W)"
	select SOC_EXYNOS7885

config MACH_EXYNOS7885_JACKPOTLTE_EUR_OPEN
	bool "Galaxy A8 (SM-A530F)"
	select SOC_EXYNOS7885

config MACH_EXYNOS7885_JACKPOTLTE_JPN_DCM
	bool "Galaxy A8 (SM-A530J)"
	select SOC_EXYNOS7885

config MACH_EXYNOS7885_JACKPOTLTE_KOR
	bool "Galaxy A8 (SM-A530N)"
	select SOC_EXYNOS7885

endchoice

endmenu

endif
```

## drivers/media/platform/exynos/fimc-is2/vendor/mcd/Kconfig
```kconfig
config CAMERA_EEPROM_SUPPORT_REAR
        bool "Enable eeprom for rear cam"
        depends on VENDER_MCD
        default n
        help
          Enable eeprom for rear cam.
config CAMERA_EEPROM_SUPPORT_FRONT
        bool "Enable eeprom for front cam"
        depends on VENDER_MCD
        default n
        help
          Enable eeprom for front cam.
config COMPANION_USE
        bool "Use companion"
        depends on VENDER_MCD
        default n
        help
          Use companion.
 config COMPANION_C1_USE
        bool "Use companion C1"
        depends on VENDER_MCD
        default n
        help
          Use companion C1.
 config COMPANION_C2_USE
        bool "Use companion C2"
        depends on VENDER_MCD
        default n
        help
          Use companion C2.
 config COMPANION_C3_USE
        bool "Use companion C3"
        depends on VENDER_MCD
        default n
        help
          Use companion C3.
 config COMPANION_DIRECT_USE
        bool "Use direct control for companion"
        depends on VENDER_MCD
        depends on COMPANION_USE
        depends on USE_DIRECT_IS_CONTROL
        default n
        help
          Use device companion direct control.
 config COMPANION_C2_DIRECT_USE
        bool "Use direct control for companion C2"
        depends on VENDER_MCD
        depends on COMPANION_C2_USE
        depends on COMPANION_DIRECT_USE
        default n
        help
          Use device companion C2.
 config COMPANION_C3_DIRECT_USE
        bool "Use direct control for companion C3"
        depends on VENDER_MCD
        depends on COMPANION_C3_USE
        depends on COMPANION_DIRECT_USE
        default n
        help
          Use device companion C3.
config COMPANION_DCDC_USE
        bool "Use companion DCDC regulator"
        depends on VENDER_MCD
        default n
        help
          Use companion DCDC regulator.
config PREPROCESSOR_STANDBY_USE
        bool "Use companion standby"
        depends on VENDER_MCD
        default n
        help
          Use companion standby.
config SENSOR_RETENTION_USE
	bool "Use sensor retention"
	depends on VENDER_MCD
	default n
	help
	  Use sensor retention.
config OIS_USE
        bool "Use ois"
        depends on VENDER_MCD
        default n
        help
          Use ois.
config OIS_FW_UPDATE_THREAD_USE
        bool "Enable ois fw update thread"
        depends on OIS_USE
        default n
        help
          Enable ois fw update thread.
config AF_HOST_CONTROL
        bool "Enable host af control"
        depends on VENDER_MCD
        default n
        help
          Enable host af control.
config TORCH_CURRENT_CHANGE_SUPPORT
        bool "Change torch current in recording mode"
        depends on VENDER_MCD
        default n
        help
          Change torch current in recording mode.
config OIS_USE_RUMBA_S4
        bool "Use RUMBA S4 ois driver IC"
        depends on OIS_USE
        default n
        help
          Use RUMBA S4 ois driver IC.
config CAMERA_JACKPOT
        bool "This camera is jackpot project"
        depends on VENDER_MCD
        default n
        help
          This camera is jackpot project.
config CAMERA_J3TOPE
        bool "This camera is j3tope project"
        depends on VENDER_MCD
        default n
        help
          This camera is j3tope project.
config CAMERA_J7TOPE
        bool "This camera is j7tope project"
        depends on VENDER_MCD
        default n
        help
          This camera is j7tope project.
config CAMERA_J7DUO
        bool "This camera is j7duo project"
        depends on VENDER_MCD
        default n
        help
          This camera is j7duo project.
config CAMERA_JACKPOT_JPN
        bool "This camera is jackpotjpn project"
        depends on VENDER_MCD
        default n
        help
          This camera is jackpotjpn project.
config CAMERA_A6E
        bool "This camera is a6e project"
        depends on VENDER_MCD
        default n
        help
          This camera is a6e project.
config CAMERA_OTPROM_SUPPORT_FRONT
        bool "This camera is otp front project"
        depends on VENDER_MCD
        default n
        help
          This camera is otp front project.
```

## drivers/motor/Kconfig
```kconfig
	  
config MOTOR_ZH915
	tristate "motor"
	default n
	help
	  Say Y to enable MOTOR ZH915.

config SEC_VIB
	tristate "SEC DC Vibrator"
	default n
	help
		If you say yes here you will get support for the
		SEC DC Vibrator.

config MOTOR_S2MU004
	tristate "s2mu004 haptic driver"
	default n
	depends on I2C
	help
	 Say Y to include support for S.LSI S2MU004 Haptic driver.
```

## drivers/muic/Kconfig
```kconfig
#
# MUIC devices
#

comment "MUIC configs"

config USE_MUIC
	bool "Using MUIC device driver"
	depends on I2C
	default n
	help
	  If you say yes here you will get support for
	  the MUIC device driver.

config USE_SAFEOUT
	bool "Using SAFEOUT device driver"
	depends on I2C
	default n
	help
	  If you say yes here you will get support for
	  the SAFEOUT device driver.

config MUIC_NOTIFIER
	bool "MUIC notifier support"
	depends on USE_MUIC
	default n
	help
	  If you say yes here you will get support for
	  the MUIC attached device status change notification.

config MUIC_MANAGER
	bool "MUIC Manager supports CCIC chip interface"
	depends on USE_MUIC && MFD_S2MU004
	default n
	help
	  If you say yes here you will get support manager for the CCIC chip.

config MUIC_HV
	bool "MUIC_HV"
	depends on USE_MUIC
	default n
	help
	  If you say yes here you will get support for the AFC.

config MUIC_HV_12V
	bool "MUIC_HV_12V"
	depends on MUIC_HV
	default n
	help
	  If you say yes here you will get support for the AFC.

config MUIC_SUPPORT_CCIC
	bool "MUIC supports CCIC chip interface"
	depends on USE_MUIC && MFD_S2MU004
	default n
	help
	  If you say yes here you will get support for the CCIC chip.

config MUIC_S2MU004
	bool "Using S2MU004 MUIC"
	depends on USE_MUIC && MFD_S2MU004
	default n
	help
	  If you say yes here you will get support for the S2MU004 MUIC chip.

config HV_MUIC_S2MU004_AFC
	bool "Using S2MU004 MUIC AFC"
	depends on MUIC_S2MU004
	default n
	help
	  If you say yes here you will get support for the AFC.

config HV_MUIC_VOLTAGE_CTRL
	bool "Using AFC Voltage control functionality"
	depends on MUIC_HV_S2MU004_AFC
	default n
	help
	  If you say yes here you will get support for
	  the AFC voltage control functionality.

config MUIC_S2MU005
	bool "Using S2MU005 MUIC"
	depends on USE_MUIC && MFD_S2MU005
	default n
	help
	  If you say yes here you will get support for
	  for the S2MU005 MUIC chip.

config MUIC_S2MU005_ENABLE_AUTOSW
	bool "Using S2MU005 MUIC ENABLE AUTOSW"
	depends on MUIC_S2MU005
	default n
	help
	  If you say yes here you will get support for
	  for the S2MU005 MUIC chip ENABLE AUTOSW feature.

config MUIC_S2MU005_DISCHARGING_WA
	bool "Using S2MU005 MUIC DISCHARGING WORKAROUND"
	depends on MUIC_S2MU005
	default n
	help
		If you say yes here you will get support for
		for the S2MU005 MUIC chip DISCHARGING WA feature.
config HICCUP_CHARGER
	bool "Using HICCUP charger"
	depends on USE_MUIC
	default n
	help
		If you say yes here you will get support for
		for the hiccup charger feature.
config CP_UART_SWITCH
	bool "Using CP UART PATH"
	depends on USE_MUIC
	default n
	help
		If you say yes here you will get support for
		for the cp uart path feature.

config NEW_FACTORY_JIGONB
	bool "Using JIGONB control"
	depends on USE_MUIC
	default n
	help
		If you say yes here you will get support for
		for the jigonb control.

config MUIC_INCOMPATIBLE_VZW
	bool "Using Verizon incomatible type"
	depends on USE_MUIC
	default n
	help
		If you say yes here you will get support for
		for the Verizon incomatible type cable.
```

## drivers/sensors/Kconfig
```kconfig
#
# Sensor  drivers configuration
#

menuconfig SENSORS
	bool "Sensor devices"
	help
	  Say Y here, and a list of sensors drivers will be displayed.
	  Everything that didn't fit into the other categories is here. This option
	  doesn't affect the kernel.

	  If unsure, say Y.

config SENSORS_CORE
	bool "Sensors Class Support"
	help
	  This option enables the sensor sysfs class in /sys/class/sensors.
	  You'll need this to do anything useful with sensorss. If unsure, say N.

config SENSORS_LSM6DSL
	tristate "STMicroelectronics LSM6DSL sensor"
	depends on (I2C || SPI) && SYSFS
	help
	   This driver support the STMicroelectronics LSM6DSL sensor.

	   To compile this driver as a module, choose M here. The module
	   will be called lsm6dsl.

config SENSORS_LSM6DSL_I2C
	tristate "STMicroelectronics LSM6DSL sensor"
	depends on (I2C || SPI) && SYSFS
	help
	   This driver support the STMicroelectronics LSM6DSL sensor.

config SENSORS_LSM6DSL_SPI
	tristate "STMicroelectronics LSM6DSL sensor"
	depends on (I2C || SPI) && SYSFS
	help
	   This driver support the STMicroelectronics LSM6DSL sensor.

config SENSORS_LIS2DS
	tristate "STMicroelectronics LIS2DS/LIS2DS12 sensors"
	depends on (I2C || SPI) && SYSFS
	help
	   This driver support the STMicroelectronics LIS2DS/LIS2DS12 sensors.
	   It is a accelerometer device.
	   To compile this driver as a module, choose M here. The module
	   will be called lis2ds.

config SENSORS_LIS2DS_I2C
	tristate "STMicroelectronics LIS2DS/LIS2DS12 sensors"
	depends on (I2C || SPI) && SYSFS
	help
	   This driver support the STMicroelectronics LIS2DS/LIS2DS12 sensors.
	   It is a accelerometer device.
	   To compile this driver as a module, choose M here. The module
	   will be called lis2ds.

config SENSORS_LIS2DS_SPI
	tristate "STMicroelectronics LIS2DS/LIS2DS12 sensors"
	depends on (I2C || SPI) && SYSFS
	help
	   This driver support the STMicroelectronics LIS2DS/LIS2DS12 sensors.
	   It is a accelerometer device.
	   To compile this driver as a module, choose M here. The module
	   will be called lis2ds.


config SENSORS_K2HH
	tristate "K2HH driver"
	depends on I2C
	default n
	help
	  Say Y here if you use SENSORS_K2HH.
	  This option enables accelerometer sensor using
	  STMicroelectronic K2HH device driver.
	  To compile this driver as a module, choose M here: the
	  module will be called K2HH.

config SENSORS_YAS539
	tristate "YAS539 Sensor Driver"
	depends on I2C
	default n
	help
	  If you say yes here you get support for YAMAHA
	  YAS539 Geomagnitor Sensor.

config SENSORS_GP2AP070S
	depends on I2C
	tristate "GP2AP070S driver"
	default n
	help
	  This option enables proximity sensor using GP2AP070S driver.
	  
config SENSORS_STK3013
	depends on I2C
	tristate "STK3013 driver"
	default n
	help
	  This option enables proximity sensor using STK3013 driver.

config SENSORS_CM36686
	depends on I2C
	tristate "CM36686 driver"
	default n
	help
	  This option enables proximity & light sensors using CM36686 driver.

config SENSORS_CM36672P
	tristate "CM36672P driver"
	depends on I2C
	default n
	help
	  Say Y here if you use SENSORS_CM36672P.
	  This option enables proximity sensor using
	  CM36672P driver.
	  To compile this driver as a module, choose M here: the
	  module will be called CM36672P.

config SENSORS_TMD3725
	depends on I2C
	tristate "TMD3725 driver"
	default n
	help
	   This option enables proximity & light sensors using TMD3725 driver.

config SENSORS_TMD3725_RF_NOISE_DEFENCE_CODE
	depends on SENSORS_TMD3725
	tristate "TMD3725 driver defence code feature"
	default n
	help
	   This option enables proximity using defence code in TMD3725 driver.

config SENSORS_A96T3X6
	depends on I2C
	tristate "A96T3X6 touchkey"
	default n
	help
	  Say Y here if you use A96T3X6 for grip.
	  This option enables grip sensors using
	  Above A96T3X6 device driver for grip.

	  Say N here if you do not use A96T3X6 for grip.
```

## drivers/staging/sec_abc/Kconfig
```kconfig
# drivers/staging/sec_abc/Kconfig
#
# Copyright (c) 2010-2011 Samsung Electronics Co., Ltd.
#		http://www.samsung.com/
#
# Licensed under GPLv2

comment "Samsung ABC Options"
config SEC_ABC
	bool "Samsung TN ABC Feature"
	default n
	help
	  Samsung TN ABC Feature
```

## drivers/video/fbdev/exynos/dpu_7885/panels/Kconfig
```kconfig
config EXYNOS_DECON_LCD
	depends on EXYNOS_DECON_7885
	bool "Select LCD panel driver"

config DISPLAY_USE_INFO
	depends on EXYNOS_DECON_LCD
	tristate "Support display use info logging"
	default n

config EXYNOS_DECON_MDNIE_LITE
	depends on EXYNOS_DECON_LCD
	tristate "Support MDNIE LITE"
	default n

config EXYNOS_DECON_LCD_S6E3FA0
	depends on EXYNOS_DECON_LCD && EXYNOS_MIPI_DSIM
	tristate "S6E3FA0 AMOLED FHD LCD driver"

config EXYNOS_DECON_LCD_S6E3FA3
	depends on EXYNOS_DECON_LCD && EXYNOS_MIPI_DSIM
	tristate "S6E3FA3 AMOLED FHD LCD driver"

config EXYNOS_DECON_LCD_S6E3FA7
	depends on EXYNOS_DECON_LCD && EXYNOS_MIPI_DSIM
	tristate "S6E3FA7 AMOLED FHD+ LCD driver"

config EXYNOS_DECON_LCD_S6E3FA7_A5Y18
	depends on EXYNOS_DECON_LCD && EXYNOS_MIPI_DSIM
	tristate "S6E3FA7 AMOLED FHD+ LCD driver"

config EXYNOS_DECON_LCD_S6E3FA7_A7Y18
	depends on EXYNOS_DECON_LCD && EXYNOS_MIPI_DSIM
	tristate "S6E3FA7 AMOLED FHD+ LCD driver"

config EXYNOS_DECON_LCD_TD4100_J3TOPE
	depends on EXYNOS_DECON_LCD
	bool "TD4100_J3TOPE TFT INCELL HD LCD driver"

config EXYNOS_DECON_LCD_S6D7AT0B_J7TOPE
	depends on EXYNOS_DECON_LCD
	bool "S6D7AT0B_J7TOPE TFT INCELL HD LCD driver"

config EXYNOS_DECON_LCD_EA8061S_J7DUO
	depends on EXYNOS_DECON_LCD
	bool "EA8061S_J7DUO AMOLED HD driver"

config EXYNOS_DECON_LCD_S6E8AA5_A6ELTE
	depends on EXYNOS_DECON_LCD
	bool "S6E8AA5_A6ELTE AMOLED HDP driver"

config EXYNOS_DECON_LCD_S6E8AA5_FEEL2
	depends on EXYNOS_DECON_LCD
	bool "S6E8AA5_FEEL2 AMOLED HDP driver"
```
